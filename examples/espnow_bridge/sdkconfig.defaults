## main/Kconfig.projbuild
```kconfig
menu "ESPDrone Config"

    choice BOARD
        prompt "Board"
        default TARGET_FLYINGFREE_V01 if IDF_TARGET_ESP32
        default TARGET_FLYINGFREE_V02 if IDF_TARGET_ESP32S3
        help
            Hardware definition. Every pin below has its default for the selected board.
            The board follows the chip: idf.py set-target esp32 gives V1.0, esp32s3 gives V2.

        config TARGET_FLYINGFREE_V01
            bool "FlyingFree V1.0 (ESP32)"
            depends on IDF_TARGET_ESP32

        config TARGET_FLYINGFREE_V02
            bool "FlyingFree V2 (ESP32-S3)"
            depends on IDF_TARGET_ESP32S3
            help
                hardware/flyingfree-v2: ICM-42688-P, MMC5983MA, DPS310, 1S-3S.
    endchoice

    comment "Board: wiring of the selected target. Change only if the PCB differs."
    menu "Board"

        config PLATFORM_STRING
            string "Platform identification string"
            default "0;FF01" if TARGET_FLYINGFREE_V01
            default "0;FF02" if TARGET_FLYINGFREE_V02
            help
                Device type reported by the platform layer, "0;" is required.
                The part after it must match a deviceType in platform_boards.c.

        menu "I2C"
            config I2C0_ENABLE
                bool "Activate I2C channel 0"
                default y
                help
                    Barometer, external compass pads, range finder, EEPROM.

            config I2C1_ENABLE
                bool "Activate I2C channel 1"
                default n
                help
                    Tick if you want to use I2C channel 1

            if I2C0_ENABLE
                config I2C0_PIN_SDA
                    int "I2C0_PIN_SDA GPIO number"
                    range 0 39 if TARGET_FLYINGFREE_V01
                    range 0 48 if TARGET_FLYINGFREE_V02
                    default 21 if TARGET_FLYINGFREE_V01
                    default 47 if TARGET_FLYINGFREE_V02
                    help
                        GPIO number (IOxx) I2C0_PIN_SDA

                config I2C0_PIN_SCL
                    int "I2C0_PIN_SCL GPIO number"
                    range 0 39 if TARGET_FLYINGFREE_V01
                    range 0 48 if TARGET_FLYINGFREE_V02
                    default 22 if TARGET_FLYINGFREE_V01
                    default 48 if TARGET_FLYINGFREE_V02
                    help
                        GPIO number (IOxx) I2C0_PIN_SCL
            endif

            if I2C1_ENABLE
                config I2C1_PIN_SDA
                    int "I2C1_PIN_SDA GPIO number"
                    help
                        GPIO number (IOxx) I2C1_PIN_SDA

                config I2C1_PIN_SCL
                    int "I2C1_PIN_SCL GPIO number"
                    help
                        GPIO number (IOxx) I2C1_PIN_SCL
            endif
        endmenu


        menu "SPI"
            comment "IMU bus: SPI3 on V1.0, SPI2 on V2 (the IMU has it to itself)"

            config IMU_SPI_PIN_MISO
                int "IMU SPI MISO GPIO number"
                range 0 39 if TARGET_FLYINGFREE_V01
                range 0 48 if TARGET_FLYINGFREE_V02
                default 19 if TARGET_FLYINGFREE_V01
                default 13 if TARGET_FLYINGFREE_V02

            config IMU_SPI_PIN_MOSI
                int "IMU SPI MOSI GPIO number"
                range 0 39 if TARGET_FLYINGFREE_V01
                range 0 48 if TARGET_FLYINGFREE_V02
                default 23 if TARGET_FLYINGFREE_V01
                default 11 if TARGET_FLYINGFREE_V02

            config IMU_SPI_PIN_CLK
                int "IMU SPI clock GPIO number"
                range 0 39 if TARGET_FLYINGFREE_V01
                range 0 48 if TARGET_FLYINGFREE_V02
                default 18 if TARGET_FLYINGFREE_V01
                default 12 if TARGET_FLYINGFREE_V02

            config IMU_SPI_PIN_CS
                int "IMU SPI chip select GPIO number"
                range 0 39 if TARGET_FLYINGFREE_V01
                range 0 48 if TARGET_FLYINGFREE_V02
                default 5 if TARGET_FLYINGFREE_V01
                default 10 if TARGET_FLYINGFREE_V02

            config IMU_INT1_PIN
                int "IMU data-ready interrupt GPIO number (-1: not wired)"
                range -1 39 if TARGET_FLYINGFREE_V01
                range -1 48 if TARGET_FLYINGFREE_V02
                default -1 if TARGET_FLYINGFREE_V01
                default 9 if TARGET_FLYINGFREE_V02
                help
                    V2 takes its sample clock from this pin. V1.0 does not wire it yet and
                    uses a 1 kHz software timer.

            if TARGET_FLYINGFREE_V02
                comment "Sensor bus (SPI3): magnetometer and analog OSD"

                config SENS_SPI_PIN_MISO
                    int "Sensor SPI MISO GPIO number"
                    range 0 48
                    default 6

                config SENS_SPI_PIN_MOSI
                    int "Sensor SPI MOSI GPIO number"
                    range 0 48
                    default 5

                config SENS_SPI_PIN_CLK
                    int "Sensor SPI clock GPIO number"
                    range 0 48
                    default 4

                config MAG_SPI_PIN_CS
                    int "Magnetometer chip select GPIO number"
                    range 0 48
                    default 7

                config OSD_SPI_PIN_CS
                    int "OSD chip select GPIO number"
                    range 0 48
                    default 39
            endif
        endmenu


        menu "LEDs"
            config LED_PIN_BLUE_ENABLE
                bool "Blue Led Available"
                default y if TARGET_FLYINGFREE_V01
                default n if TARGET_FLYINGFREE_V02
                help
                    Tick if blue led available

            config LED_PIN_GREEN_ENABLE
                bool "Green Led Available"
                default y
                help
                    Tick if green led available

            config LED_PIN_RED_ENABLE
                bool "Red Led Available"
                default y
                help
                    Tick if red led available

            config LED_PIN_BLUE
                int "LED_PIN_BLUE GPIO number"
                depends on LED_PIN_BLUE_ENABLE
                range 0 39 if TARGET_FLYINGFREE_V01
                range 0 48 if TARGET_FLYINGFREE_V02
                default 16 if TARGET_FLYINGFREE_V01
                help
                    GPIO number (IOxx) LED_PIN_BLUE

            config LED_PIN_GREEN
                int "LED_PIN_GREEN GPIO number"
                depends on LED_PIN_GREEN_ENABLE
                range 0 39 if TARGET_FLYINGFREE_V01
                range 0 48 if TARGET_FLYINGFREE_V02
                default 4 if TARGET_FLYINGFREE_V01
                default 46 if TARGET_FLYINGFREE_V02
                help
                    GPIO number (IOxx) LED_PIN_GREEN

            config LED_PIN_RED
                int "LED_PIN_RED GPIO number"
                depends on LED_PIN_RED_ENABLE
                range 0 39 if TARGET_FLYINGFREE_V01
                range 0 48 if TARGET_FLYINGFREE_V02
                default 17 if TARGET_FLYINGFREE_V01
                default 45 if TARGET_FLYINGFREE_V02
                help
                    GPIO number (IOxx) LED_PIN_RED
        endmenu


        menu "Buzzer"
            config BUZZER_ENABLE
                bool "enable buzzer to play sound"
                default y
                    help
                    Tick if buzzer available

            if BUZZER_ENABLE
                config BUZ1_PIN_POS
                    int "BUZ1_PIN_POS GPIO number"
                    range 0 39 if TARGET_FLYINGFREE_V01
                    range 0 48 if TARGET_FLYINGFREE_V02
                    default 2 if TARGET_FLYINGFREE_V01
                    default 3 if TARGET_FLYINGFREE_V02
                    help
                        GPIO number (IOxx) BUZ1_PIN_POS
            endif
        endmenu


        menu "Battery voltage and current sense (ADC)"
            config ADC_ENABLE
                bool "At least one ADC channel available"
                default y
                help
                    Tick if you want to use an ADC channel

            if ADC_ENABLE
                config VBAT_ADC_PIN
                    int "Battery voltage GPIO number (ADC1)"
                    range 32 39 if TARGET_FLYINGFREE_V01
                    range 1 10 if TARGET_FLYINGFREE_V02
                    default 34 if TARGET_FLYINGFREE_V01
                    default 1 if TARGET_FLYINGFREE_V02
                    help
                        Pin of the battery divider. Must be an ADC1 pin: ADC2 does not work while
                        Wi-Fi runs.

                config CURR_ADC_ENABLE
                    bool "ESC current sensor input"
                    default n if TARGET_FLYINGFREE_V01
                    default y if TARGET_FLYINGFREE_V02

                config CURR_ADC_PIN
                    int "ESC current sensor GPIO number (ADC1)"
                    depends on CURR_ADC_ENABLE
                    range 32 39 if TARGET_FLYINGFREE_V01
                    range 1 10 if TARGET_FLYINGFREE_V02
                    default 2 if TARGET_FLYINGFREE_V02
                    default 35

                config CURR_AMP_PER_VOLT_X100
                    int "Current sensor scale (A per V, x100)"
                    depends on CURR_ADC_ENABLE
                    range 1 100000
                    default 2500
                    help
                        From the ESC's documentation. 2500 means 25 A per volt (40 mV/A).
            endif
        endmenu

    endmenu

    menu "Sensors"

        config QMC5883L_ENABLE
            bool "Magnetometer QMC5883L (I2C0)"
            depends on TARGET_FLYINGFREE_V01
            default y

        config BMP280_ENABLE
            bool "Barometer BMP280"
            depends on TARGET_FLYINGFREE_V01
            default n
            help
                No working BMP280 driver yet; the option only reserves the place.

        config MMC5983MA_ENABLE
            bool "Magnetometer MMC5983MA (SPI3)"
            depends on TARGET_FLYINGFREE_V02
            default y

        config MMC5983MA_RATE_1000HZ
            bool "Sample the magnetometer at 1 kHz"
            depends on MMC5983MA_ENABLE
            default n
            help
                1 kHz continuous mode (1.2 mG rms). Off: 100 Hz (0.4 mG rms).

        config DPS310_ENABLE
            bool "Barometer DPS310 (I2C0)"
            depends on TARGET_FLYINGFREE_V02
            default y

        config RANGE_VL53L0X_ENABLE
            bool "Range finder VL53L0X"
            default y if TARGET_FLYINGFREE_V01
            default n

        config UPSIDEDOWN_ENABLE
            bool "Board mounted upside down"
            default y if TARGET_FLYINGFREE_V01
            default n
            help
                Flips the Z axis (and the matching X) of the IMU and the magnetometer.

        config PITCH_CALIB
            int "Pitch trim (deg*100)"
            range -400 400
            default 0
            help
                If the vehicle rests at a pitch error of 0.90 degrees, enter 90.

        config ROLL_CALIB
            int "Roll trim (deg*100)"
            range -400 400
            default 0
            help
                If the vehicle rests at a roll error of 0.90 degrees, enter 90.

    endmenu

    menu "Motors & ESC"
        choice MOTOR_TYPE
            prompt "Motor Type"
            default BRUSHLESS
            
            config BRUSHLESS
                bool "Brushless Motors"
    
            config BRUSHED
                bool "Brushed DC motors"

        endchoice

        choice MOTOR_PROTOCOL
            prompt "Control protocol"
            default DSHOT_150 if BRUSHLESS
            default PWM if BRUSHED
            
            config DSHOT_150
                bool "DShot150"
                depends on BRUSHLESS
    
            config DSHOT_300
                bool "DShot300"
                depends on BRUSHLESS

            config DSHOT_600
                bool "DShot600"
                depends on BRUSHLESS
    
            config PWM
                bool "PWM"
                depends on BRUSHED
        endchoice

        config MOTOR_THRUST_MAX
            int "Maximum motor command (DShot units, 48 = 0 %, 2047 = 100 %)"
            depends on BRUSHLESS
            range 100 2047
            default 1000
            help
                Upper limit of the commander thrust and of every motor output after mixing.
                1000 is about 48 % throttle, raise it once the vehicle is tuned.
        comment "V2: motors on GPIO33-36, which do not glitch at power-up. Do not use GPIO1-18."
        config MOTOR01_PIN
            int "MOTOR01_PIN GPIO number"
            range 0 39 if TARGET_FLYINGFREE_V01
            range 0 48 if TARGET_FLYINGFREE_V02
            default 27 if TARGET_FLYINGFREE_V01
            default 33 if TARGET_FLYINGFREE_V02
            help
                GPIO number (IOxx) MOTOR01_PIN

        config MOTOR02_PIN
            int "MOTOR02_PIN GPIO number"
            range 0 39 if TARGET_FLYINGFREE_V01
            range 0 48 if TARGET_FLYINGFREE_V02
            default 26 if TARGET_FLYINGFREE_V01
            default 34 if TARGET_FLYINGFREE_V02
            help
                GPIO number (IOxx) MOTOR02_PIN

        config MOTOR03_PIN
            int "MOTOR03_PIN GPIO number"
            range 0 39 if TARGET_FLYINGFREE_V01
            range 0 48 if TARGET_FLYINGFREE_V02
            default 25 if TARGET_FLYINGFREE_V01
            default 35 if TARGET_FLYINGFREE_V02
            help
                GPIO number (IOxx) MOTOR03_PIN

        config MOTOR04_PIN
            int "MOTOR04_PIN GPIO number"
            range 0 39 if TARGET_FLYINGFREE_V01
            range 0 48 if TARGET_FLYINGFREE_V02
            default 33 if TARGET_FLYINGFREE_V01
            default 36 if TARGET_FLYINGFREE_V02
            help
                GPIO number (IOxx) MOTOR04_PIN
    endmenu

    menu "Power"

        choice BATTERY
            prompt "Battery"
            default BATTERY_3S

            config BATTERY_1S
                bool "1S LiPo"
                depends on TARGET_FLYINGFREE_V02
            config BATTERY_2S
                bool "2S LiPo"
                depends on TARGET_FLYINGFREE_V02
            config BATTERY_3S
                bool "3S LiPo"
            config BATTERY_4S
                bool "4S LiPo"
                depends on TARGET_FLYINGFREE_V01
        endchoice

        config BATTERY_CELLS
            int
            default 1 if BATTERY_1S
            default 2 if BATTERY_2S
            default 3 if BATTERY_3S
            default 4 if BATTERY_4S

        config BATTERY_CELL_LOW_MV
            int "Low battery warning (mV per cell)"
            range 3000 3700
            default 3200
            help
                Pack voltage below this value (times the number of cells) for 5 s raises the low battery state.

        config BATTERY_CELL_CRITICAL_MV
            int "Critical battery (mV per cell)"
            range 2800 3600
            default 3000
            help
                Pack voltage below this value (times the number of cells) for 5 s is treated as critical.

    endmenu

    menu "Receiver & Link"
        menu "Wi-Fi access point"
            config WIFI_BASE_SSID
                string "Wi-Fi Base SSID"
                default "ESP-DRONE"
                help
                    Wi-Fi Base SSID, 1-16 characters. the final SSID will be BASE_SSID-MAC
            config WIFI_PASSWORD
                string "Wi-Fi Password"
                default "12345678"
                help
                    Wi-Fi Password, 8-64 characters
            config WIFI_CHANNEL
                int "Wi-Fi/ESP-Now Channel"
                range 1 13
                default 6
                help
                    Wi-Fi/ESP-Now Channel, 1-13
            config WIFI_MAX_STA_CONN
                int "Wi-Fi Max Station Connection"
                range 1 6
                default 3
                help
                    Wi-Fi Max Station Connection, 1-6
        endmenu

        menu "ESP-NOW control link"
            config ESPNOW_CTRL_ENABLE
                bool "Enable the ESP-NOW control link"
                default y
                help
                    Receive control frames from a transmitter over ESP-NOW. The wire format is in
                    espnow_link.h. ESP-NOW uses the channel of the Wi-Fi access point.
            config ESPNOW_CTRL_PEER_MAC
                string "Transmitter MAC address (STA MAC)"
                depends on ESPNOW_CTRL_ENABLE
                default ""
                help
                    Format aa:bb:cc:dd:ee:ff. Only frames from this address are accepted.
                    Leave empty to accept control from ANY transmitter on the channel (bench use only).
            config ESPNOW_CTRL_ENCRYPT
                bool "Encrypt the control link"
                depends on ESPNOW_CTRL_ENABLE
                default n
                help
                    Needs a transmitter MAC and the same PMK and LMK on the transmitter. The transmitter
                    must send unicast to the drone's AP MAC.
            config ESPNOW_CTRL_PMK
                string "Primary master key (16 characters)"
                depends on ESPNOW_CTRL_ENCRYPT
                default ""
            config ESPNOW_CTRL_LMK
                string "Local master key (16 characters)"
                depends on ESPNOW_CTRL_ENCRYPT
                default ""
            config ESPNOW_CTRL_LINK_TIMEOUT_MS
                int "Link timeout (ms)"
                depends on ESPNOW_CTRL_ENABLE
                range 50 2000
                default 250
                help
                    Time without a valid control frame after which the failsafe is triggered.
            config ESPNOW_CTRL_FAILSAFE_DISARM
                bool "Disarm on link loss"
                depends on ESPNOW_CTRL_ENABLE
                default y
                help
                    On link loss the setpoint is set to level attitude with zero thrust. This also disarms
                    the drone, arming again needs a new ARM edge from the transmitter.
            config ESPNOW_CTRL_START_DISARMED
                bool "Start disarmed"
                depends on ESPNOW_CTRL_ENABLE
                default y
                help
                    Boot disarmed so the transmitter has to arm the drone. cfclient can still arm by
                    setting the system.forceArm parameter.
            config ESPNOW_CTRL_STATUS_PERIOD_MS
                int "Status frame period (ms)"
                depends on ESPNOW_CTRL_ENABLE
                range 20 1000
                default 100
            config ESPNOW_CTRL_TELEMETRY_PERIOD_MS
                int "Telemetry frame period (ms, 0 = off)"
                depends on ESPNOW_CTRL_ENABLE
                range 0 1000
                default 50
                help
                    Attitude, rates, thrust, motor outputs and battery, sent to the transmitter
                    while the link is up. 50 ms is 20 Hz, about 1.3 kB/s of airtime.
            config ESPNOW_CTRL_MAX_ANGLE_DEG
                int "Roll/pitch angle at full stick (deg)"
                depends on ESPNOW_CTRL_ENABLE
                range 1 45
                default 15
            config ESPNOW_CTRL_MAX_YAW_RATE_DPS
                int "Yaw rate at full stick (deg/s)"
                depends on ESPNOW_CTRL_ENABLE
                range 1 360
                default 30
            config ESPNOW_CTRL_THRUST_MAX
                int "Thrust sent to the commander at full throttle"
                depends on ESPNOW_CTRL_ENABLE
                range 48 2047
                default 300
                help
                    Same scale as the commander thrust (DShot 48-2047). The brushless mixer limits the
                    output to DEFAULT_MAX_THRUST in power_distribution_stock.c. The previous ESP-NOW
                    decoder topped out at 300, which is kept as the default.
        endmenu


        config ENABLE_LEGACY_APP
            bool "Accept packets of the legacy ESPlane 1.0 app"
            default n
            help
                Decodes the 11 byte UDP control packets of the first ESPlane app.
    endmenu

    menu "Failsafe & Arming"

        config FAILSAFE_STABILIZE_TIMEOUT_MS
            int "No setpoint: level the vehicle after (ms)"
            range 100 5000
            default 500
            help
                Time without a new setpoint from any link after which the commander forces
                roll and pitch to zero and keeps the last thrust.

        config FAILSAFE_SHUTDOWN_TIMEOUT_MS
            int "No setpoint: cut the thrust after (ms)"
            range 200 20000
            default 2000
            help
                Time without a new setpoint after which the commander drops to a null setpoint.
                Must be larger than the stabilize timeout.

        comment "Arming and link-loss behaviour of the ESP-NOW link are in Receiver & Link."

    endmenu

    menu "Flight control"

        config ENABLE_POSITION_HOLD_MODE
            bool "Position hold mode"
            default y
            help
                Allows position and altitude hold when the sensors for it are fitted.

        config ENABLE_COMMAND_MODE_SET
            bool "Allow the client to switch the flight mode"
            depends on ENABLE_POSITION_HOLD_MODE
            default y

        menu "PID gains"
            comment "Gains are entered times 1000 (75000 = 75.0). They are also tunable at run time through the CRTP params."

        menu "Rate controller (deg/s -> torque)"
        config PID_ROLL_RATE_KP
            int "Roll rate Kp (x0.001)"
            range 0 1000000
            default 75000
        config PID_ROLL_RATE_KI
            int "Roll rate Ki (x0.001)"
            range 0 1000000
            default 500
        config PID_ROLL_RATE_KD
            int "Roll rate Kd (x0.001)"
            range 0 1000000
            default 1000
        config PID_ROLL_RATE_INTEGRATION_LIMIT
            int "Roll rate integral limit (x0.001)"
            range 0 1000000
            default 33300
        config PID_PITCH_RATE_KP
            int "Pitch rate Kp (x0.001)"
            range 0 1000000
            default 85000
        config PID_PITCH_RATE_KI
            int "Pitch rate Ki (x0.001)"
            range 0 1000000
            default 2000
        config PID_PITCH_RATE_KD
            int "Pitch rate Kd (x0.001)"
            range 0 1000000
            default 1000
        config PID_PITCH_RATE_INTEGRATION_LIMIT
            int "Pitch rate integral limit (x0.001)"
            range 0 1000000
            default 33300
        config PID_YAW_RATE_KP
            int "Yaw rate Kp (x0.001)"
            range 0 1000000
            default 0
        config PID_YAW_RATE_KI
            int "Yaw rate Ki (x0.001)"
            range 0 1000000
            default 0
        config PID_YAW_RATE_KD
            int "Yaw rate Kd (x0.001)"
            range 0 1000000
            default 0
        config PID_YAW_RATE_INTEGRATION_LIMIT
            int "Yaw rate integral limit (x0.001)"
            range 0 1000000
            default 166700
        endmenu
        menu "Attitude controller (deg -> deg/s)"
        config PID_ROLL_KP
            int "Roll Kp (x0.001)"
            range 0 1000000
            default 10000
        config PID_ROLL_KI
            int "Roll Ki (x0.001)"
            range 0 1000000
            default 1000
        config PID_ROLL_KD
            int "Roll Kd (x0.001)"
            range 0 1000000
            default 100
        config PID_ROLL_INTEGRATION_LIMIT
            int "Roll integral limit (x0.001)"
            range 0 1000000
            default 20000
        config PID_PITCH_KP
            int "Pitch Kp (x0.001)"
            range 0 1000000
            default 12000
        config PID_PITCH_KI
            int "Pitch Ki (x0.001)"
            range 0 1000000
            default 2000
        config PID_PITCH_KD
            int "Pitch Kd (x0.001)"
            range 0 1000000
            default 100
        config PID_PITCH_INTEGRATION_LIMIT
            int "Pitch integral limit (x0.001)"
            range 0 1000000
            default 20000
        config PID_YAW_KP
            int "Yaw Kp (x0.001)"
            range 0 1000000
            default 0
        config PID_YAW_KI
            int "Yaw Ki (x0.001)"
            range 0 1000000
            default 0
        config PID_YAW_KD
            int "Yaw Kd (x0.001)"
            range 0 1000000
            default 0
        config PID_YAW_INTEGRATION_LIMIT
            int "Yaw integral limit (x0.001)"
            range 0 1000000
            default 50000
        endmenu
        endmenu

    endmenu

    menu "Debug & logging"

        choice DEBUG_OUTPUT
            prompt "Debug message output"
            default DEBUG_PRINT_ON_ESPLOG
            help
                Where DEBUG_PRINTx messages go.

            config DEBUG_PRINT_ON_ESPLOG
                bool "ESP-IDF log (console UART)"

            config DEBUG_PRINT_ON_SEGGER_RTT
                bool "SEGGER SystemView over JTAG"
                depends on APPTRACE_SV_ENABLE
                help
                    Needs the trace destination set to JTAG and SystemView enabled under
                    Component config -> Application Level Tracing. profiles/sysview.defaults
                    does that.
        endchoice

    endmenu
    menu "System"

        config BASE_STACK_SIZE
            int "base stack size for system task"
            range 512 1024
            default 1024 if IDF_TARGET_ESP32
            default 512 if IDF_TARGET_ESP32S2
            default 1024 if IDF_TARGET_ESP32S3
    endmenu

endmenu
```
